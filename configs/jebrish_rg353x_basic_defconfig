## package/raylib/Config.in
```kconfig
config BR2_PACKAGE_RAYLIB
	bool "raylib"
#   select BR2_PACKAGE_MESA3D
#	depends on BR2_TOOLCHAIN_HEADERS_AT_LEAST_5_0
#	select BR2_PACKAGE_RAYLIB
	help
	  Raylib Graphics Package.

	  https://www.raylib.com/index.html

if BR2_PACKAGE_RAYLIB

config BR2_RAYLIB_BUILD_EXAMPLES
    bool "Include Raylib Examples"

if BR2_RAYLIB_BUILD_EXAMPLES

    config BR2_RAYLIB_EXAMPLE_WIDTH
        int "Example Width"
        default 640
    
    config BR2_RAYLIB_EXAMPLE_HEIGHT
        int "Example Height"
        default 480

endif # BR2_RAYLIB_BUILD_EXAMPLES

choice
    prompt "Backend"
    default BR2_RAYLIB_BACKEND_DRM

config BR2_RAYLIB_BACKEND_DRM
    bool "DRM"
    #select BR2_PACKAGE_HAS_LIBEGL_WAYLAND

config BR2_RAYLIB_BACKEND_X11
    bool "X11"
    #select BR2_PACKAGE_XORG7
    #select BR2_PACKAGE_WESTON
    #select BR2_PACKAGE_WESTON_XWAYLAND

endchoice

endif # BR2_PACKAGE_RAYLIB

# comment "cfm needs a toolchain w/ threads, kernel headers >= 5.0"
# 	depends on !BR2_TOOLCHAIN_HAS_THREADS \
# 		|| !BR2_TOOLCHAIN_HEADERS_AT_LEAST_5_0
```

## package/rayminapp/Config.in
```kconfig
config BR2_PACKAGE_RAYMINAPP
	bool "rayminapp"
 	depends on BR2_PACKAGE_RAYLIB
	help
	  Raylib Minimal Application

if BR2_PACKAGE_RAYMINAPP

    config BR2_RAYMINAPP_WIDTH
        int "Application Width"
        default 640
    
    config BR2_RAYMINAPP_HEIGHT
        int "Application Height"
        default 480

endif # BR2_PACKAGE_RAYMINAPP
```
